## BME688/VF/Yocto/meta-vf/conf/layer.conf
```bitbake
# We have a conf and classes directory, add to BBPATH
BBPATH .= ":${LAYERDIR}"

# We have recipes-* directories, add to BBFILES
BBFILES += "${LAYERDIR}/recipes-*/*/*.bb \
            ${LAYERDIR}/recipes-*/*/*.bbappend"

BBFILE_COLLECTIONS += "meta-vf"
BBFILE_PATTERN_meta-vf = "^${LAYERDIR}/"
BBFILE_PRIORITY_meta-vf = "6"

LAYERDEPENDS_meta-vf = "core"
LAYERSERIES_COMPAT_meta-vf = "dunfell"
```
